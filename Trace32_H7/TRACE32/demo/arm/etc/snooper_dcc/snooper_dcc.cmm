; --------------------------------------------------------------------------------
; @Title: SNOOPer over DCC Demo for ARM7/9/11, XSCALE, CortexA/R
; @Description: 
;   This script shows how to use the SNOOPer trace with mode DCC
;   The demo code is compiled as position independent code and should run on 
;   every ARM platform except CortexM which dooes not support DCC.
;   The demo application periodically writes the content of the 32bit
;   mcount variable to the DCC register. The debugger checks the DCC registers
;   in a defined sampling rate and enters the recieved information into the
;   SNOOPer trace buffer
;   For more information about the SNOOPer trace, please refer to
;   app_snooper.pdf
;
;   Prerequisites:
;    * System is connected
;    * RAM is accessible Read/Write/Execute
;    * The application has to run on core 0
;
;   Usage:
;          DO ~~/demo/arm/etc/snooper_dcc/snooper_dcc.cmm <RamStart>
;     e.g. DO ~~/demo/arm/etc/snooper_dcc/snooper_dcc.cmm 0x1000
; @Author: KJM
; @Keywords: SNOOPer DCC
; @Copyright: (C) 1989-2022 Lauterbach GmbH, licensed for use with TRACE32(R) only
; --------------------------------------------------------------------------------
; $Id: snooper_dcc.cmm 18850 2022-01-26 18:41:29Z bschroefel $


; clear windows
WinCLEAR

PRIVATE &param &offset
ENTRY &param

IF !SYSTEM.UP()
(
  PRINT %ERROR "Error: Please connect to the CPU first."
  ENDDO FALSE()
)

IF CORE.NUMBER()>1
  CORE 0

GOSUB ParseParameters &param
ENTRY &offset

IF (STRing.SCAN(CORENAME(),"ARM7",0)>=0)||(STRing.SCAN(CORENAME(),"ARM9",0)>=0)
(
  Data.LOAD.Elf ~~~~/snooper_dcc_pic_arm7_arm9.elf          &offset /RelPATH /Verify
)
ELSE IF (STRing.SCAN(CORENAME(),"ARM11",0)>=0)||(STRing.SCAN(CORENAME(),"CORTEXA",0)>=0)
(
  Data.LOAD.Elf ~~~~/snooper_dcc_pic_arm11_cortex.elf       &offset /RelPATH /Verify
)
ELSE IF (STRing.SCAN(CORENAME(),"XSCALE",0)>=0)
(
  Data.LOAD.Elf ~~~~/snooper_dcc_pic_xscale.elf             &offset /RelPATH /Verify
)
ELSE IF (STRing.SCAN(CORENAME(),"CORTEXR",0)>=0)
(
  IF ((Data.Long(C15:0x1)&0x80000000)!=0x0)
    Data.LOAD.Elf ~~~~/snooper_dcc_pic_arm11_cortex_be.elf  &offset /RelPATH /Verify
  ELSE
    Data.LOAD.Elf ~~~~/snooper_dcc_pic_arm11_cortex.elf     &offset /RelPATH /Verify
)
ELSE
(
  PRINT %ERROR "Error: Coretype not supported by this script."
  ENDDO FALSE()
)

; preboot executable - run to *main*
Go main
WAIT !STATE.RUN()

SNOOPer.RESet
SNOOPer.Mode DCC

Trace.METHOD SNOOPer

; show windows
WinPOS 0% 0%
List.auto
WinPOS 50% 0%
SNOOPer.List
WinPOS 0% 52%
SNOOPer.state

Go
WAIT 3.s
Break

ENDDO TRUE()

; --------------------------------------------------------------------------------
; SUBROUTINES
;
ParseParameters: ;(param)
  LOCAL &param &offset
  ENTRY &param
  &offset=STRing.SCANAndExtract("&param","0x","")
  IF "&offset"==""
  (
    PRINT %ERROR "Error: Missing Argument - Usage DO fdxtrace.cmm 0x<offset> "
    ENDDO FALSE()
  )
  ; ensure parameter is HEX and round down to the nearest LONG
  &offset="0x&offset"
  &offset=(&offset)&~0x3

  IF !SYStem.Up()
  (
    PRINT %ERROR "Error: Not connected to target. - Please use SYStem.Up before."
    ENDDO FALSE()
  )

  RETURN &offset
