; --------------------------------------------------------------------------------
; @Title: Script File to load ETB raw data in the TRACE32 Simulator
; @Description: 
;   This script loads the ETB raw data in the TRACE32 Simulator.
;   You need to edit the script to setup exactely the same ETM
;   configuration used when the trace data has been generated.
;   Otherwhise the raw data cannot be correctly decoded.
; @Keywords: ETB, raw, simulator, trace
; @Author: -
; @Copyright: (C) 1989-2022 Lauterbach GmbH, licensed for use with TRACE32(R) only
; --------------------------------------------------------------------------------
; $Id: etb_sim_import.cmm 20803 2023-04-20 09:33:18Z bschroefel $


; System Settings

	SYStem.CPU *
	; set any address here to enable the ETM in TRACE32
	SYStem.CONFIG ETMBASE 0x1000
	SYStem.Up
	
; Load the target code
	Data.LOAD.Elf *
	
; ETM Settings, Please note that these settings must match the used ETM settings
; when recording the trace. Otherwhise, the displayed trace here could contain 
; erros.
	ETM.PortSize 32.
	ETM.ContextID OFF
	ETM.PortMode  Normal
	ETM.DataTrace OFF
	
; Import trace data
	LA.Mode FLOWTRACE ON
	LA.IMPORT.ETB etb.bin
	LA.List
	
	ENDDO
	
