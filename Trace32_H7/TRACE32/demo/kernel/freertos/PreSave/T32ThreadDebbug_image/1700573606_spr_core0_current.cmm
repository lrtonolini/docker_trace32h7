// System Control
 PER.Set.simple ESD:0xE000E008 %Long 0x1000
 PER.Set.simple ESD:0xE000E010 %Long 0x0
 PER.Set.simple ESD:0xE000E014 %Long 0x0
 PER.Set.simple ESD:0xE000E018 %Long 0x0
 // PER.Set.simple ESD:0xE000E01C %Long 0x400003E8
 // PER.Set.simple ESD:0xE000ED00 %Long 0x411FC271
 PER.Set.simple ESD:0xE000ED04 %Long 0xC9C000
 PER.Set.simple ESD:0xE000ED08 %Long 0x20000000
 PER.Set.simple ESD:0xE000ED0C %Long 0xFA050300
 PER.Set.simple ESD:0xE000ED10 %Long 0x10
 PER.Set.simple ESD:0xE000ED14 %Long 0x70200
 PER.Set.simple ESD:0xE000ED18 %Long 0x0
 PER.Set.simple ESD:0xE000ED1C %Long 0xE0000000
 PER.Set.simple ESD:0xE000ED20 %Long 0xF0F000F0
 PER.Set.simple ESD:0xE000ED24 %Long 0x0
 PER.Set.simple ESD:0xE000ED28 %Byte 0x0
 PER.Set.simple ESD:0xE000ED29 %Byte 0x0
 PER.Set.simple ESD:0xE000ED2A %Word 0x0
 PER.Set.simple ESD:0xE000ED2C %Long 0x0
 PER.Set.simple ESD:0xE000ED30 %Long 0x2
 PER.Set.simple ESD:0xE000ED34 %Long 0x0
 PER.Set.simple ESD:0xE000ED38 %Long 0x0
 PER.Set.simple ESD:0xE000ED3C %Long 0x0
 PER.Set.simple ESD:0xE000ED88 %Long 0xF00000
// Memory System
 // PER.Set.simple ESD:0xE000ED78 %Long 0x9000003
 // PER.Set.simple ESD:0xE000ED7C %Long 0x8303C003
 // PER.Set.simple ESD:0xE000ED80 %Long 0xF00FE019
 PER.Set.simple ESD:0xE000ED84 %Long 0x0
 PER.Set.simple ESD:0xE000EF90 %Long 0x3B
 PER.Set.simple ESD:0xE000EF94 %Long 0x43
 PER.Set.simple ESD:0xE000EF98 %Long 0x7
 PER.Set.simple ESD:0xE000EF9C %Long 0x0
 PER.Set.simple ESD:0xE000EFA0 %Long 0x800
 PER.Set.simple ESD:0xE000EFA8 %Long 0x0
 PER.Set.simple ESD:0xE000EFB0 %Long 0x0
 PER.Set.simple ESD:0xE000EFB4 %Long 0x0
 PER.Set.simple ESD:0xE000EFB8 %Long 0x0
 PER.Set.simple ESD:0xE000EFBC %Long 0x0
// Feature Registers
 // PER.Set.simple ESD:0xE000ED40 %Long 0x30
 // PER.Set.simple ESD:0xE000ED44 %Long 0x200
 // PER.Set.simple ESD:0xE000ED48 %Long 0x100000
 // PER.Set.simple ESD:0xE000ED50 %Long 0x110030
 // PER.Set.simple ESD:0xE000ED58 %Long 0x1000000
 // PER.Set.simple ESD:0xE000ED60 %Long 0x1101110
 // PER.Set.simple ESD:0xE000ED64 %Long 0x2112000
 // PER.Set.simple ESD:0xE000ED68 %Long 0x20232231
 // PER.Set.simple ESD:0xE000ED6C %Long 0x1111131
 // PER.Set.simple ESD:0xE000ED70 %Long 0x1310132
// CoreSight Identification Registers
 // PER.Set.simple ESD:0xE000EFE0 %Long 0x0C
 // PER.Set.simple ESD:0xE000EFE4 %Long 0xB0
 // PER.Set.simple ESD:0xE000EFE8 %Long 0x0B
 // PER.Set.simple ESD:0xE000EFEC %Long 0x0
 // PER.Set.simple ESD:0xE000EFD0 %Long 0x4
 // PER.Set.simple ESD:0xE000EFF0 %Long 0x0D
 // PER.Set.simple ESD:0xE000EFF4 %Long 0xE0
 // PER.Set.simple ESD:0xE000EFF8 %Long 0x5
 // PER.Set.simple ESD:0xE000EFFC %Long 0xB1
// Memory Protection Unit (MPU)
 // PER.Set.simple ESD:0xE000ED90 %Long 0x1000
 PER.Set.simple ESD:0xE000ED94 %Long 0x7
 PER.Set.simple ESD:0xE000ED98 %Long 0x0F
// MPU regions
 PER.Set.SaveIndex ESD:0xE000ED98 %Long 0x0 ESD:0xE000ED9C %Long 0x0
 PER.Set.SaveIndex ESD:0xE000ED98 %Long 0x0 ESD:0xE000EDA0 %Long 0x602F039
 PER.Set.SaveIndex ESD:0xE000ED98 %Long 0x1 ESD:0xE000ED9C %Long 0x1
 PER.Set.SaveIndex ESD:0xE000ED98 %Long 0x1 ESD:0xE000EDA0 %Long 0x130BF53F
 PER.Set.SaveIndex ESD:0xE000ED98 %Long 0x2 ESD:0xE000ED9C %Long 0x80000002
 PER.Set.SaveIndex ESD:0xE000ED98 %Long 0x2 ESD:0xE000EDA0 %Long 0x13020039
 PER.Set.SaveIndex ESD:0xE000ED98 %Long 0x3 ESD:0xE000ED9C %Long 0x3
 PER.Set.SaveIndex ESD:0xE000ED98 %Long 0x3 ESD:0xE000EDA0 %Long 0x13020739
 PER.Set.SaveIndex ESD:0xE000ED98 %Long 0x4 ESD:0xE000ED9C %Long 0x4
 PER.Set.SaveIndex ESD:0xE000ED98 %Long 0x4 ESD:0xE000EDA0 %Long 0x0
 PER.Set.SaveIndex ESD:0xE000ED98 %Long 0x5 ESD:0xE000ED9C %Long 0x5
 PER.Set.SaveIndex ESD:0xE000ED98 %Long 0x5 ESD:0xE000EDA0 %Long 0x0
 PER.Set.SaveIndex ESD:0xE000ED98 %Long 0x6 ESD:0xE000ED9C %Long 0x6
 PER.Set.SaveIndex ESD:0xE000ED98 %Long 0x6 ESD:0xE000EDA0 %Long 0x0
 PER.Set.SaveIndex ESD:0xE000ED98 %Long 0x7 ESD:0xE000ED9C %Long 0x7
 PER.Set.SaveIndex ESD:0xE000ED98 %Long 0x7 ESD:0xE000EDA0 %Long 0x0
 PER.Set.SaveIndex ESD:0xE000ED98 %Long 0x8 ESD:0xE000ED9C %Long 0x8
 PER.Set.SaveIndex ESD:0xE000ED98 %Long 0x8 ESD:0xE000EDA0 %Long 0x0
 PER.Set.SaveIndex ESD:0xE000ED98 %Long 0x9 ESD:0xE000ED9C %Long 0x9
 PER.Set.SaveIndex ESD:0xE000ED98 %Long 0x9 ESD:0xE000EDA0 %Long 0x0
 PER.Set.SaveIndex ESD:0xE000ED98 %Long 0x0A ESD:0xE000ED9C %Long 0x0A
 PER.Set.SaveIndex ESD:0xE000ED98 %Long 0x0A ESD:0xE000EDA0 %Long 0x0
 PER.Set.SaveIndex ESD:0xE000ED98 %Long 0x0B ESD:0xE000ED9C %Long 0x0B
 PER.Set.SaveIndex ESD:0xE000ED98 %Long 0x0B ESD:0xE000EDA0 %Long 0x0
 PER.Set.SaveIndex ESD:0xE000ED98 %Long 0x0C ESD:0xE000ED9C %Long 0x0C
 PER.Set.SaveIndex ESD:0xE000ED98 %Long 0x0C ESD:0xE000EDA0 %Long 0x0
 PER.Set.SaveIndex ESD:0xE000ED98 %Long 0x0D ESD:0xE000ED9C %Long 0x0D
 PER.Set.SaveIndex ESD:0xE000ED98 %Long 0x0D ESD:0xE000EDA0 %Long 0x0
 PER.Set.SaveIndex ESD:0xE000ED98 %Long 0x0E ESD:0xE000ED9C %Long 0x0E
 PER.Set.SaveIndex ESD:0xE000ED98 %Long 0x0E ESD:0xE000EDA0 %Long 0x0
 PER.Set.SaveIndex ESD:0xE000ED98 %Long 0x0F ESD:0xE000ED9C %Long 0x0F
 PER.Set.SaveIndex ESD:0xE000ED98 %Long 0x0F ESD:0xE000EDA0 %Long 0x0
// Nested Vectored Interrupt Controller (NVIC)
 // PER.Set.simple ESD:0xE000E004 %Long 0x4
// Interrupt Enable Registers
 PER.Set.simple ESD:0xE000E100 %Long 0x0
 PER.Set.simple ESD:0xE000E104 %Long 0x40000
 PER.Set.simple ESD:0xE000E108 %Long 0x2000
 PER.Set.simple ESD:0xE000E10C %Long 0x0
 PER.Set.simple ESD:0xE000E110 %Long 0x1000
// Interrupt Pending Registers
 PER.Set.simple ESD:0xE000E200 %Long 0x0
 PER.Set.simple ESD:0xE000E204 %Long 0x0
 PER.Set.simple ESD:0xE000E208 %Long 0x2000
 PER.Set.simple ESD:0xE000E20C %Long 0x0
 PER.Set.simple ESD:0xE000E210 %Long 0x1000
// Interrupt Active Bit Registers
 // PER.Set.simple ESD:0xE000E300 %Long 0x0
 // PER.Set.simple ESD:0xE000E304 %Long 0x0
 // PER.Set.simple ESD:0xE000E308 %Long 0x0
 // PER.Set.simple ESD:0xE000E30C %Long 0x0
 // PER.Set.simple ESD:0xE000E310 %Long 0x0
// Interrupt Priority Registers
 PER.Set.simple ESD:0xE000E400 %Long 0x0
 PER.Set.simple ESD:0xE000E404 %Long 0x0
 PER.Set.simple ESD:0xE000E408 %Long 0x0
 PER.Set.simple ESD:0xE000E40C %Long 0x0
 PER.Set.simple ESD:0xE000E410 %Long 0x0
 PER.Set.simple ESD:0xE000E414 %Long 0x0
 PER.Set.simple ESD:0xE000E418 %Long 0x0
 PER.Set.simple ESD:0xE000E41C %Long 0x20000000
 PER.Set.simple ESD:0xE000E420 %Long 0x20
 PER.Set.simple ESD:0xE000E424 %Long 0x0
 PER.Set.simple ESD:0xE000E428 %Long 0x0
 PER.Set.simple ESD:0xE000E42C %Long 0x0
 PER.Set.simple ESD:0xE000E430 %Long 0x0
 PER.Set.simple ESD:0xE000E434 %Long 0x0
 PER.Set.simple ESD:0xE000E438 %Long 0x0
 PER.Set.simple ESD:0xE000E43C %Long 0x0
 PER.Set.simple ESD:0xE000E440 %Long 0x0
 PER.Set.simple ESD:0xE000E444 %Long 0x0
 PER.Set.simple ESD:0xE000E448 %Long 0x0
 PER.Set.simple ESD:0xE000E44C %Long 0x1000
 PER.Set.simple ESD:0xE000E450 %Long 0x0
 PER.Set.simple ESD:0xE000E454 %Long 0x0
 PER.Set.simple ESD:0xE000E458 %Long 0x0
 PER.Set.simple ESD:0xE000E45C %Long 0x0
 PER.Set.simple ESD:0xE000E460 %Long 0x0
 PER.Set.simple ESD:0xE000E464 %Long 0x0
 PER.Set.simple ESD:0xE000E468 %Long 0x0
 PER.Set.simple ESD:0xE000E46C %Long 0x0
 PER.Set.simple ESD:0xE000E470 %Long 0x0
 PER.Set.simple ESD:0xE000E474 %Long 0x0
 PER.Set.simple ESD:0xE000E478 %Long 0x0
 PER.Set.simple ESD:0xE000E47C %Long 0x0
 PER.Set.simple ESD:0xE000E480 %Long 0x0
 PER.Set.simple ESD:0xE000E484 %Long 0x0
 PER.Set.simple ESD:0xE000E488 %Long 0x0
 PER.Set.simple ESD:0xE000E48C %Long 0x0
 PER.Set.simple ESD:0xE000E490 %Long 0x0
 PER.Set.simple ESD:0xE000E494 %Long 0x0
 PER.Set.simple ESD:0xE000E498 %Long 0x0
 PER.Set.simple ESD:0xE000E49C %Long 0x0
// Floating-point Unit (FPU)
 PER.Set.simple ESD:0xE000EF34 %Long 0xC0000018
 PER.Set.simple ESD:0xE000EF38 %Long 0x2400C3D0
 PER.Set.simple ESD:0xE000EF3C %Long 0x0
 // PER.Set.simple ESD:0xE000EF40 %Long 0x10110221
 // PER.Set.simple ESD:0xE000EF44 %Long 0x12000011
 // PER.Set.simple ESD:0xE000EF48 %Long 0x40
// Debug
// Core Debug
 PER.Set.simple ESD:0xE000ED30 %Long 0x2
 PER.Set.simple ESD:0xE000EDF8 %Long 0x6000000
 PER.Set.simple ESD:0xE000EDFC %Long 0x10107F1
// Flash Patch and Breakpoint Unit (FPB)
 PER.Set.simple ESD:0xE0002000 %Long 0x10000081
 PER.Set.simple ESD:0xE0002008 %Long 0x804036D
 PER.Set.simple ESD:0xE000200C %Long 0x0
 PER.Set.simple ESD:0xE0002010 %Long 0x0
 PER.Set.simple ESD:0xE0002014 %Long 0x0
 PER.Set.simple ESD:0xE0002018 %Long 0x0
 PER.Set.simple ESD:0xE000201C %Long 0x0
 PER.Set.simple ESD:0xE0002020 %Long 0x0
 PER.Set.simple ESD:0xE0002024 %Long 0x0
// CoreSight Identification Registers
 // PER.Set.simple ESD:0xE0002FE0 %Long 0x0E
 // PER.Set.simple ESD:0xE0002FE4 %Long 0xB0
 // PER.Set.simple ESD:0xE0002FE8 %Long 0x0B
 // PER.Set.simple ESD:0xE0002FEC %Long 0x0
 // PER.Set.simple ESD:0xE0002FD0 %Long 0x4
 // PER.Set.simple ESD:0xE0002FF0 %Long 0x0D
 // PER.Set.simple ESD:0xE0002FF4 %Long 0xE0
 // PER.Set.simple ESD:0xE0002FF8 %Long 0x5
 // PER.Set.simple ESD:0xE0002FFC %Long 0xB1
// Data Watchpoint and Trace Unit (DWT)
 PER.Set.simple ESD:0xE0001000 %Long 0x40000000
 PER.Set.simple ESD:0xE0001004 %Long 0x0
 PER.Set.simple ESD:0xE0001008 %Long 0x0
 PER.Set.simple ESD:0xE000100C %Long 0x0
 PER.Set.simple ESD:0xE0001010 %Long 0x0
 PER.Set.simple ESD:0xE0001014 %Long 0x0
 PER.Set.simple ESD:0xE0001018 %Long 0x0
 // PER.Set.simple ESD:0xE000101C %Long 0xFFFFFFFF
 PER.Set.simple ESD:0xE0001020 %Long 0x0
 PER.Set.simple ESD:0xE0001024 %Long 0x0
 PER.Set.simple ESD:0xE0001028 %Long 0x0
 PER.Set.simple ESD:0xE0001030 %Long 0x0
 PER.Set.simple ESD:0xE0001034 %Long 0x0
 PER.Set.simple ESD:0xE0001038 %Long 0x200
 PER.Set.simple ESD:0xE0001040 %Long 0x0
 PER.Set.simple ESD:0xE0001044 %Long 0x0
 PER.Set.simple ESD:0xE0001048 %Long 0x0
 PER.Set.simple ESD:0xE0001050 %Long 0x0
 PER.Set.simple ESD:0xE0001054 %Long 0x0
 PER.Set.simple ESD:0xE0001058 %Long 0x0
// CoreSight Identification Registers
 // PER.Set.simple ESD:0xE0001FE0 %Long 0x2
 // PER.Set.simple ESD:0xE0001FE4 %Long 0xB0
 // PER.Set.simple ESD:0xE0001FE8 %Long 0x0B
 // PER.Set.simple ESD:0xE0001FEC %Long 0x0
 // PER.Set.simple ESD:0xE0001FD0 %Long 0x4
 // PER.Set.simple ESD:0xE0001FF0 %Long 0x0D
 // PER.Set.simple ESD:0xE0001FF4 %Long 0xE0
 // PER.Set.simple ESD:0xE0001FF8 %Long 0x5
 // PER.Set.simple ESD:0xE0001FFC %Long 0xB1
