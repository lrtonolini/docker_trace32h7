// The next serial ports will be used by the GDB FrontEnd startup script
// if are defined here with non empty values

GLOBAL &GDBPORT
GLOBAL &TERMPORT

IF OS.NAME()=="Windows"
(
  &GDBPORT=""     ; e.g. &GDBPORT="COM8"
  &TERMPORT=""    ; e.g. &TERMPORT="COM9"
)
ELSE IF OS.NAME()=="Linux"
(
  &GDBPORT=""     ; e.g. &GDBPORT="/dev/ttyACM0"
  &TERMPORT=""    ; e.g. &TERMPORT="/dev/ttyACM1"
)

// === PORTENTA-H7 and NICLA VISION FLASH UTILITY ===
// If &DFUUTIL is not defined here, by default the demos start scripts will search for
// Arduino's dfu-util flash programmer at his default location:
// Windows: ~/AppData/Local/Arduino15/packages/arduino/tools/dfu-util/0.10.0-arduino1/dfu-util.exe
// Linux: ~/.arduino15/packages/arduino/tools/dfu-util/0.10.0-arduino1/dfu-util
// Note: in TRACE32 '~' means your user directory
//
// In case you have dfu-util in a different path, please define it in &DFUUTIL here below:

GLOBAL &DFUUTIL
&DFUUTIL=""   ; not defined, use default search path

// === NANO 33 BLE FLASH UTILITY ===
// If &BOSSAC is not defined here, by default the demos start scripts will search for
// Arduino's bossac flash programmer at his default location:
// Windows: ~/AppData/Local/Arduino15/packages/arduino/tools/bossac/1.9.1-arduino2/bossac.exe
// Linux: ~/.arduino15/packages/arduino/tools/bossac/1.9.1-arduino2/bossac
// Note: in TRACE32 '~' means your user directory
//
// In case you have bossac in a different path, please define it in &BOSSAC here below:

GLOBAL &BOSSAC
&BOSSAC=""   ; not defined, use default search path

// Additional menu to start demos for Portenta H7 or Nano 33 BLE


Do "~~/menu.cmm"
ENDDO