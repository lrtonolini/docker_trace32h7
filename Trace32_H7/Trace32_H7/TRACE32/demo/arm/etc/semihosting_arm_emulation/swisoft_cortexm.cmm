; --------------------------------------------------------------------------------
; @Title: Cortex-M3 Compatible Semihosting via Software Breakpoint Instruction
; @Description: 
;   After executing this script you need to run the loaded dhrystone benchmark
;   program ('Go')
;   Enter a value e.g. '100000' in the TERM.GATE window. The program stops until
;   the value has been entered.
;   The benchmark program uses semihosting for inputs and outputs in the TERM.GATE
;   window.
;   See dhry.h if you want to know details on what the benchmark program does.
;   See the target manual of the arm debugger (debugger_arm.pdf) for more details
;   about 'semihosting'.
; @Author: PEG
; @Keywords: SWI TERM.GATE
; @Chip: Cortex-M?
; @Copyright: (C) 1989-2022 Lauterbach GmbH, licensed for use with TRACE32(R) only
; --------------------------------------------------------------------------------
; $Id: swisoft_cortexm.cmm 18850 2022-01-26 18:41:29Z bschroefel $


; The debugger is expected to be in UP state, therefore a target
; specific start-up script will be needed to run first.


; start-up in case of simulator

  IF INTERFACE.SIM()
  (
    RESet
    SYStem.CPU CORTEXM3
    SYStem.Up
  )

; load demo application
  Data.LOAD.Elf ~~~~/dhrystone_cortexm.axf /spath /lpath /noclear

; configure and open semihosting channel
  TERM.HEAPINFO 0 0x20000 0x30000 0x20000
  TERM.METHOD armswi
  TERM.Mode string

; open some windows
  WinCLEAR
  WinPOS 0% 0% 100% 48%
  List.auto
  WinPOS 0% 50% 50% 48%
  Frame /Locals /Caller
  WinPOS 50% 50% 50% 48%
  TERM.GATE

  ENDDO

