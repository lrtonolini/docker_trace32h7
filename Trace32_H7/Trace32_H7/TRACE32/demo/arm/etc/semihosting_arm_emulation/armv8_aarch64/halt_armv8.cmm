; --------------------------------------------------------------------------------
; @Title: ARMV8/Cortex-A5x compatible semihosting using HALT 0xF000 instruction
; @Description: The example assumes RAM at address 0x80000000.
; @Keywords: AARCH, ARMv8 armcc, Cortex-A53, Cortex-A57, Semi-hosting
; @Author: BES
; @Copyright: (C) 1989-2022 Lauterbach GmbH, licensed for use with TRACE32(R) only
; --------------------------------------------------------------------------------
; $Id: halt_armv8.cmm 20803 2023-04-20 09:33:18Z bschroefel $


; After executing this script you need to run the loaded dhrystone benchmark program (-> 'Go').
; Enter a value e.g. '100000' in the TERM.GATE window. The program stops until the value has been entered. 
; The benchmark program uses semihosting for inputs and outputs in the TERM.GATE window.
; See dhry.h if you want to know details on what the benchmark program does.
; See the target manual of the arm debugger (debugger_armv8.pdf) for more details about 'semihosting'.

; Alternatively you could run the termdemo.axf application which demonstrates semihosting file I/O.
; It outputs 'Hello World!' in the TERM.GATE window and offers you a menu to 
; 'r' read and type an ascii file named test1 which needs to be in the current directory.
; 'w' write the text 'Hello World!' in an ascii file named test2 in the current directory.
; 'p' print 32 times the line 'Performance Test Text'.

; The debugger is expected to be in UP state, therefore a target
; specific start-up script will be needed to run first.
;

; start-up in case of simulator
  IF INTERFACE.SIM()
  (
    LOCAL &CPSR
  
    RESet
    SYStem.CPU ARMV8-A
    SYStem.Up
    
    &CPSR=Register(cpsr)
    Register.Set cpsr (&CPSR&0xFFFFFFEF)    ; Go to AArch64
  )

  if (Register(cpsr)&0x10)==0x10
  (
    Dialog.OK "Processor is not in AArch64 mode!"
    ENDDO
  )

; load demo application
  Data.LOAD.ELF dhrystone.elf /spath /lpath /noclear

; configure and open semihosting channel
  TERM.HEAPINFO 0x80010000 0x80020000 0x80030000 0x80020000
  TERM.METHOD armswi
  TERM.Mode string

; open some windows
  WinCLEAR
  WinPOS 0% 0% 100% 48%
  List.auto
  WinPOS 0% 50% 50% 48%
  Frame /Locals /Caller
  WinPOS 50% 50% 50% 48%
  TERM.GATE

  ENDDO

