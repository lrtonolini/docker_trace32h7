## Trace32_H7/Trace32_H7/TRACE32/demo/zephyr/src/zephyr/build/Kconfig/arch/Kconfig
```kconfig
# Load arch Kconfig descriptions.
osource "C:/Users/Lily-RoseTonolini/zephyrproject/zephyr/arch/x86/Kconfig"
osource "C:/Users/Lily-RoseTonolini/zephyrproject/zephyr/arch/xtensa/Kconfig"
osource "C:/Users/Lily-RoseTonolini/zephyrproject/zephyr/arch/sparc/Kconfig"
osource "C:/Users/Lily-RoseTonolini/zephyrproject/zephyr/arch/riscv/Kconfig"
osource "C:/Users/Lily-RoseTonolini/zephyrproject/zephyr/arch/posix/Kconfig"
osource "C:/Users/Lily-RoseTonolini/zephyrproject/zephyr/arch/nios2/Kconfig"
osource "C:/Users/Lily-RoseTonolini/zephyrproject/zephyr/arch/mips/Kconfig"
osource "C:/Users/Lily-RoseTonolini/zephyrproject/zephyr/arch/arm64/Kconfig"
osource "C:/Users/Lily-RoseTonolini/zephyrproject/zephyr/arch/arm/Kconfig"
osource "C:/Users/Lily-RoseTonolini/zephyrproject/zephyr/arch/arc/Kconfig"
```
